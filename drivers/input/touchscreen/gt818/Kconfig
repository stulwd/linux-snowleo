## drivers/input/touchscreen/gt818/Kconfig
```kconfig
#
#  Touchscreen driver configuration
#

config  TOUCHSCREEN_GT818
       tristate  "gt818 touchscreen driver"      
       depends on INPUT && I2C
       default m
       help
         gt818 touchscreen driver    
```
